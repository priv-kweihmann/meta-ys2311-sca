## conf/layer.conf
```bitbake
# Demo layer for Yocto Summit 23.11
## SPDX-License-Identifier: BSD-2-Clause
## Copyright (c) 2023, Konrad Weihmann

BBPATH =. "${LAYERDIR}:"

BBFILES += "\
            ${LAYERDIR}/recipes-*/*/*.bb \
            ${LAYERDIR}/recipes-*/*/*.bbappend \
           "

BBFILE_COLLECTIONS += "meta-ys2311-sca"
BBFILE_PATTERN_meta-ys2311-sca = "^${LAYERDIR}/"
BBFILE_PRIORITY_meta-sca ?= "30"

LAYERVERSION_meta-ys2311-sca = "1"
LAYERDEPENDS_meta-ys2311-sca = "core meta-sca"

LAYERSERIES_COMPAT_meta-ys2311-sca = "mickledore"
```
